## main/Kconfig.projbuild
```kconfig
menu "ESP32S3 UDP RTP Configuration"
    config ESPRTP_WIFI_SSID
        string "WiFi SSID"
        default "myssid"
        help
            SSID (network name) for the device to connect to.

    config ESPRTP_WIFI_PASSWORD
        string "WiFi Password"
        default "mypassword"
        help
            WiFi password (WPA or WPA2) for the device to use.
            Can be left blank if the network has no security set.

    config ESPRTP_IPV4_ADDR
        string "Unicast IPV4 Address"
        default "192.168.1.78"
        help
            IPV4 unicast address.

    config ESPRTP_VIDEO_SUPPORT
        bool "Enable video streaming support"
        default y
        help
            Enable support for video streaming over RTP. When enabled, video RTP packets will be sent.

        config ESPRTP_UDP_VIDEO_PORT
            int "UDP Video Port"
            default 4000
            range 1 65535
            depends on ESPRTP_VIDEO_SUPPORT
            help
                Port number for video RTP streaming. The device will send video RTP packets to this port.
                Note: RTP ports are typically even numbers.

    config ESPRTP_AUDIO_SUPPORT
        bool "Enable audio streaming support"
        default y
        help
            Enable support for audio streaming over RTP. When enabled, audio RTP packets will be sent.

        config ESPRTP_UDP_AUDIO_PORT
            int "UDP Audio Port"
            default 4002
            range 1 65535
            depends on ESPRTP_AUDIO_SUPPORT
            help
                Port number for audio RTP streaming. The device will send audio RTP packets to this port.
                Note: RTP ports are typically even numbers.


endmenu
```
